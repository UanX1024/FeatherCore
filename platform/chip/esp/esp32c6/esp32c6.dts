/* Device Tree Source for ESP32-C6 */
/dts-v1/;

/ {
    compatible = "espressif,esp32c6";
    model = "Espressif ESP32-C6";
    #address-cells = <1>;
    #size-cells = <1>;

    cpus {
        #address-cells = <1>;
        #size-cells = <0>;

        cpu@0 {
            device_type = "cpu";
            compatible = "riscv,esp32c6";
            reg = <0>;
        };
    };
};
