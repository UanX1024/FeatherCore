/* Device Tree Source for ESP32-C3 */
/dts-v1/;

/ {
    compatible = "espressif,esp32c3";
    model = "Espressif ESP32-C3";
    #address-cells = <1>;
    #size-cells = <1>;

    cpus {
        #address-cells = <1>;
        #size-cells = <0>;

        cpu@0 {
            device_type = "cpu";
            compatible = "riscv,esp32c3";
            reg = <0>;
        };
    };
};
