/* Device Tree Source for RA8 */
/dts-v1/;

/ {
    compatible = "renesas,ra8";
    model = "Renesas RA8";
    #address-cells = <1>;
    #size-cells = <1>;

    cpus {
        #address-cells = <1>;
        #size-cells = <0>;

        cpu@0 {
            device_type = "cpu";
            compatible = "arm,cortex-m85";
            reg = <0>;
        };
    };
};
