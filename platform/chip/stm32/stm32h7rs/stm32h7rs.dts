/* Device Tree Source for STM32H7RS series */
/dts-v1/;

/ {
    compatible = "st,stm32h7rs";
    model = "STMicroelectronics STM32H7RS series";
    #address-cells = <1>;
    #size-cells = <1>;

    cpus {
        #address-cells = <1>;
        #size-cells = <0>;

        cpu@0 {
            device_type = "cpu";
            compatible = "arm,cortex-m7";
            reg = <0>;
        };
    };
};
