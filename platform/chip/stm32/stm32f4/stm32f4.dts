/* Device Tree Source for STM32F4 series */
/dts-v1/;

/ {
    compatible = "st,stm32f4";
    model = "STMicroelectronics STM32F4 series";
    #address-cells = <1>;
    #size-cells = <1>;

    cpus {
        #address-cells = <1>;
        #size-cells = <0>;

        cpu@0 {
            device_type = "cpu";
            compatible = "arm,cortex-m4";
            reg = <0>;
        };
    };
};
