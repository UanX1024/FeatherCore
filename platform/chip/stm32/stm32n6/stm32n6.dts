/* Device Tree Source for STM32N6 series */
/dts-v1/;

/ {
    compatible = "st,stm32n6";
    model = "STMicroelectronics STM32N6 series";
    #address-cells = <1>;
    #size-cells = <1>;

    cpus {
        #address-cells = <1>;
        #size-cells = <0>;

        cpu@0 {
            device_type = "cpu";
            compatible = "arm,cortex-m55";
            reg = <0>;
        };
    };
};
