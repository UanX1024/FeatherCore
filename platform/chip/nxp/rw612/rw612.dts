/* Device Tree Source for RW612 */
/dts-v1/;

/ {
    compatible = "nxp,rw612";
    model = "NXP RW612";
    #address-cells = <1>;
    #size-cells = <1>;

    cpus {
        #address-cells = <1>;
        #size-cells = <0>;

        cpu@0 {
            device_type = "cpu";
            compatible = "arm,cortex-m33";
            reg = <0>;
        };
    };
};
