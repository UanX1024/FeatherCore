/* Device Tree Source for i.MX RT1170 */
/dts-v1/;

/ {
    compatible = "nxp,imxrt1170";
    model = "NXP i.MX RT1170";
    #address-cells = <1>;
    #size-cells = <1>;

    cpus {
        #address-cells = <1>;
        #size-cells = <0>;

        cpu@0 {
            device_type = "cpu";
            compatible = "arm,cortex-m7";
            reg = <0>;
        };
    };
};
